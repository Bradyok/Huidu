## br2-huidu/Config.in
```kconfig
menu "Huidu PX30 packages"

source "$BR2_EXTERNAL_HUIDU_PATH/package/huidu-sender/Config.in"
source "$BR2_EXTERNAL_HUIDU_PATH/package/huidu-player/Config.in"

endmenu
```

## br2-huidu/configs/huidu_px30_bringup_defconfig
```kconfig
# Bring-up: kernel + small initramfs in the boot image (no eMMC writes). KMS test patterns via modetest, no Mesa.
BR2_aarch64=y
BR2_cortex_a35=y
BR2_TOOLCHAIN_EXTERNAL=y
BR2_TARGET_GENERIC_HOSTNAME="huidu"
BR2_TARGET_GENERIC_ISSUE="Huidu PX30 (our OS)"
# Bring-up only: replace with key-based login before any field image.
BR2_TARGET_GENERIC_ROOT_PASSWD="huidu"
BR2_TARGET_GENERIC_GETTY_PORT="ttyS2"
BR2_TARGET_GENERIC_GETTY_BAUDRATE_115200=y
BR2_SYSTEM_DHCP="eth0"
BR2_ROOTFS_DEVICE_CREATION_DYNAMIC_MDEV=y
BR2_ROOTFS_OVERLAY="$(BR2_EXTERNAL_HUIDU_PATH)/board/huidu/px30/rootfs-overlay"
BR2_ROOTFS_POST_IMAGE_SCRIPT="$(BR2_EXTERNAL_HUIDU_PATH)/board/huidu/px30/post-image.sh"
# Kernel
BR2_LINUX_KERNEL=y
BR2_LINUX_KERNEL_CUSTOM_VERSION=y
BR2_LINUX_KERNEL_CUSTOM_VERSION_VALUE="6.18.53"
BR2_LINUX_KERNEL_USE_ARCH_DEFAULT_CONFIG=y
BR2_LINUX_KERNEL_CONFIG_FRAGMENT_FILES="$(BR2_EXTERNAL_HUIDU_PATH)/board/huidu/px30/linux.fragment"
BR2_LINUX_KERNEL_DTS_SUPPORT=y
BR2_LINUX_KERNEL_CUSTOM_DTS_PATH="$(BR2_EXTERNAL_HUIDU_PATH)/board/huidu/px30/dts/rockchip/px30-huidu.dtsi $(BR2_EXTERNAL_HUIDU_PATH)/board/huidu/px30/dts/rockchip/px30-huidu-c15.dts $(BR2_EXTERNAL_HUIDU_PATH)/board/huidu/px30/dts/rockchip/px30-huidu-d15.dts"
BR2_LINUX_KERNEL_INSTALL_TARGET=y
BR2_LINUX_KERNEL_NEEDS_HOST_OPENSSL=y
BR2_PACKAGE_LINUX_FIRMWARE=y
BR2_PACKAGE_LINUX_FIRMWARE_RTL_81XX=y
# Graphics: KMS only (modetest)
BR2_PACKAGE_LIBDRM=y
BR2_PACKAGE_LIBDRM_INSTALL_TESTS=y
# Bring-up tools
BR2_PACKAGE_DROPBEAR=y
BR2_PACKAGE_E2FSPROGS=y
BR2_PACKAGE_UTIL_LINUX=y
BR2_PACKAGE_UTIL_LINUX_BINARIES=y
BR2_PACKAGE_MMC_UTILS=y
BR2_PACKAGE_I2C_TOOLS=y
BR2_PACKAGE_SPI_TOOLS=y
BR2_PACKAGE_LIBGPIOD=y
BR2_PACKAGE_LIBGPIOD_TOOLS=y
BR2_PACKAGE_DTC=y
BR2_PACKAGE_DTC_PROGRAMS=y
BR2_PACKAGE_STRACE=y
BR2_PACKAGE_EVTEST=y
BR2_PACKAGE_PICOCOM=y
BR2_PACKAGE_IW=y
BR2_PACKAGE_WPA_SUPPLICANT=y
BR2_PACKAGE_WPA_SUPPLICANT_NL80211=y
BR2_PACKAGE_CHRONY=y
# Root filesystem: initramfs, packed into boot-<model>-ramdisk.img
BR2_TARGET_ROOTFS_CPIO=y
BR2_TARGET_ROOTFS_CPIO_GZIP=y
```

## br2-huidu/configs/huidu_px30_defconfig
```kconfig
# Huidu PX30 LED controllers (C15 / C35 / C36): mainline 6.18 LTS + Panfrost, booted by the stock U-Boot.
BR2_aarch64=y
BR2_cortex_a35=y
BR2_TOOLCHAIN_EXTERNAL=y
BR2_TARGET_GENERIC_HOSTNAME="huidu"
BR2_TARGET_GENERIC_ISSUE="Huidu PX30 (our OS)"
# Bring-up only: replace with key-based login before any field image.
BR2_TARGET_GENERIC_ROOT_PASSWD="huidu"
BR2_TARGET_GENERIC_GETTY_PORT="ttyS2"
BR2_TARGET_GENERIC_GETTY_BAUDRATE_115200=y
BR2_SYSTEM_DHCP="eth0"
BR2_ROOTFS_DEVICE_CREATION_DYNAMIC_MDEV=y
BR2_ROOTFS_OVERLAY="$(BR2_EXTERNAL_HUIDU_PATH)/board/huidu/px30/rootfs-overlay"
BR2_ROOTFS_POST_IMAGE_SCRIPT="$(BR2_EXTERNAL_HUIDU_PATH)/board/huidu/px30/post-image.sh"
# Kernel
BR2_LINUX_KERNEL=y
BR2_LINUX_KERNEL_CUSTOM_VERSION=y
BR2_LINUX_KERNEL_CUSTOM_VERSION_VALUE="6.18.53"
BR2_LINUX_KERNEL_USE_ARCH_DEFAULT_CONFIG=y
BR2_LINUX_KERNEL_CONFIG_FRAGMENT_FILES="$(BR2_EXTERNAL_HUIDU_PATH)/board/huidu/px30/linux.fragment"
BR2_LINUX_KERNEL_DTS_SUPPORT=y
BR2_LINUX_KERNEL_CUSTOM_DTS_PATH="$(BR2_EXTERNAL_HUIDU_PATH)/board/huidu/px30/dts/rockchip/px30-huidu.dtsi $(BR2_EXTERNAL_HUIDU_PATH)/board/huidu/px30/dts/rockchip/px30-huidu-c15.dts $(BR2_EXTERNAL_HUIDU_PATH)/board/huidu/px30/dts/rockchip/px30-huidu-d15.dts"
BR2_LINUX_KERNEL_INSTALL_TARGET=y
BR2_LINUX_KERNEL_NEEDS_HOST_OPENSSL=y
BR2_PACKAGE_LINUX_FIRMWARE=y
BR2_PACKAGE_LINUX_FIRMWARE_RTL_81XX=y
# Graphics: Panfrost (Mali-G31) on KMS
BR2_PACKAGE_MESA3D=y
BR2_PACKAGE_MESA3D_LLVM=y
BR2_PACKAGE_MESA3D_GALLIUM_DRIVER_PANFROST=y
BR2_PACKAGE_MESA3D_GBM=y
BR2_PACKAGE_MESA3D_OPENGL_EGL=y
BR2_PACKAGE_MESA3D_OPENGL_ES=y
BR2_PACKAGE_LIBDRM=y
BR2_PACKAGE_LIBDRM_INSTALL_TESTS=y
BR2_PACKAGE_KMSCUBE=y
BR2_PACKAGE_FFMPEG=y
# Bring-up tools
BR2_PACKAGE_DROPBEAR=y
BR2_PACKAGE_E2FSPROGS=y
BR2_PACKAGE_UTIL_LINUX=y
BR2_PACKAGE_UTIL_LINUX_BINARIES=y
BR2_PACKAGE_MMC_UTILS=y
BR2_PACKAGE_I2C_TOOLS=y
BR2_PACKAGE_SPI_TOOLS=y
BR2_PACKAGE_LIBGPIOD=y
BR2_PACKAGE_LIBGPIOD_TOOLS=y
BR2_PACKAGE_DTC=y
BR2_PACKAGE_DTC_PROGRAMS=y
BR2_PACKAGE_STRACE=y
BR2_PACKAGE_EVTEST=y
BR2_PACKAGE_PICOCOM=y
BR2_PACKAGE_IW=y
BR2_PACKAGE_WPA_SUPPLICANT=y
BR2_PACKAGE_WPA_SUPPLICANT_NL80211=y
BR2_PACKAGE_CHRONY=y
# Root filesystem: ext4 on eMMC
BR2_TARGET_ROOTFS_EXT2=y
BR2_TARGET_ROOTFS_EXT2_4=y
BR2_TARGET_ROOTFS_EXT2_SIZE="768M"
```

## br2-huidu/package/huidu-player/Config.in
```kconfig
config BR2_PACKAGE_HUIDU_PLAYER
	bool "huidu-player (boxplayer)"
	depends on BR2_PACKAGE_HOST_RUSTC_TARGET_ARCH_SUPPORTS
	depends on BR2_TOOLCHAIN_HAS_THREADS # tokio, rodio
	select BR2_PACKAGE_HOST_RUSTC
	select BR2_PACKAGE_ALSA_LIB     # rodio audio playback
	select BR2_PACKAGE_ALSA_LIB_MIXER
	select BR2_PACKAGE_OPENSSL      # reqwest (native-tls) cloud/weather HTTPS
	select BR2_PACKAGE_HUIDU_SENDER # pairs with the ttyS1 control daemon
	help
	  Our Rust reproduction of Huidu's BoxPlayer display player
	  (the `boxplayer` binary): parses program/.zbin files, renders
	  scenes/text/images/gif with tiny-skia, plays audio, speaks the
	  SDK/upgrade protocols, and pushes RGB frames to the panel.

	  Pairs with huidu-sender: this produces the image, huidu-sender
	  programs the FPGA over ttyS1 so the image lights the wall.

	  https://github.com/Bradyok/Huidu (huidu-player crate)

comment "huidu-player needs a toolchain w/ host rustc + threads"
	depends on !BR2_PACKAGE_HOST_RUSTC_TARGET_ARCH_SUPPORTS || \
		!BR2_TOOLCHAIN_HAS_THREADS
```

## br2-huidu/package/huidu-sender/Config.in
```kconfig
config BR2_PACKAGE_HUIDU_SENDER
	bool "huidu-sender"
	depends on BR2_PACKAGE_HOST_RUSTC_TARGET_ARCH_SUPPORTS
	select BR2_PACKAGE_HOST_RUSTC
	help
	  Our own LED sender-card control daemon for the Huidu PX30
	  controllers (C15 / C35 / C36). Drives the FPGA config link on
	  /dev/ttyS1 (scan tables, gamma, brightness, geometry, card
	  params, status) — the same link the stock BoxPlayer uses via
	  libFPGADriver.so. Pixels do NOT go over this link; they reach
	  the panel as the SoC VOP's parallel-RGB888 output, so any KMS
	  client can produce the image while this daemon brings the LED
	  wall up and keeps it configured.

	  Runs as S95huidu-sender and serves a line-control socket on
	  127.0.0.1:7654 (brightness / status / search / lock / unlock)
	  for the player/CMS.

	  https://github.com/Bradyok/Huidu (huidu-sender crate)

comment "huidu-sender needs a toolchain w/ host rustc"
	depends on !BR2_PACKAGE_HOST_RUSTC_TARGET_ARCH_SUPPORTS
```
